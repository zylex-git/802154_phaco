## CMakeLists.txt
```
#
# Copyright (c) 2023 Nordic Semiconductor
#
# SPDX-License-Identifier: LicenseRef-Nordic-5-Clause
#

cmake_minimum_required(VERSION 3.20.0)

find_package(Zephyr REQUIRED HINTS $ENV{ZEPHYR_BASE})
project(802154_sniffer)

set(CMAKE_CXX_STANDARD 17)
set(CMAKE_CXX_STANDARD_REQUIRED ON)

target_include_directories(app PRIVATE include)

target_sources(app PRIVATE 
    src/main.cpp
    src/phaco_if.cpp
)
```

## prj.conf
```kconfig
# Enabling radio driver
CONFIG_NETWORKING=y
CONFIG_IEEE802154=y
CONFIG_IEEE802154_RAW_MODE=y
CONFIG_NET_PKT_TIMESTAMP=y

# Allow sharing the RTC between IEEE 802.15.4 and Zephyr
CONFIG_NRF_RTC_TIMER_USER_CHAN_COUNT=3

# Increase the number of RX buffers to minimize the chances of frame drops.
# The value must not be higher than 127 - X, where X is the number of notification
# slots reserved by the radio driver (see NTF_PRIMARY_POOL_SIZE macro definition).
CONFIG_NRF_802154_RX_BUFFERS=120

# Shell configuration
CONFIG_SHELL=y
CONFIG_SHELL_PROMPT_UART=""
CONFIG_SHELL_VT100_COLORS=n

# LED indication
CONFIG_DK_LIBRARY=y

# USB configuration
CONFIG_USB_DEVICE_STACK=y
CONFIG_USB_DEVICE_MANUFACTURER="Nordic Semiconductor ASA"
CONFIG_USB_DEVICE_PRODUCT="nRF 802154 Sniffer"
CONFIG_USB_DEVICE_VID=0x1915
CONFIG_USB_DEVICE_PID=0x154b
CONFIG_SHELL_BACKEND_SERIAL_CHECK_DTR=y
CONFIG_UART_LINE_CTRL=y
CONFIG_SHELL_BACKEND_SERIAL_INIT_PRIORITY=51
CONFIG_USB_DEVICE_INITIALIZE_AT_BOOT=y

# Disable boot banner
CONFIG_BOOT_BANNER=n
CONFIG_NCS_BOOT_BANNER=n

# C++ support
CONFIG_CPP=y
CONFIG_STD_CPP17=y
CONFIG_REQUIRES_FULL_LIBCPP=y
CONFIG_GLIBCXX_LIBCPP=y

# CDC ACM buffer support
CONFIG_USB_DEVICE_STACK=y
CONFIG_USB_CDC_ACM=y
CONFIG_SERIAL=y
CONFIG_UART_LINE_CTRL=y
CONFIG_UART_INTERRUPT_DRIVEN=y
CONFIG_UART_USE_RUNTIME_CONFIGURE=y
CONFIG_LOG=y 
CONFIG_UART_LOG_LEVEL_ERR=y
CONFIG_UART_LOG_LEVEL_DBG=y
```

## boards/nrf52840dk_nrf52840.overlay
```dts
/*
 * Copyright (c) 2023 Nordic Semiconductor ASA
 *
 * SPDX-License-Identifier: LicenseRef-Nordic-5-Clause
 */

/ {
	chosen {
		zephyr,shell-uart = &cdc_acm_uart0;
	};
};

&zephyr_udc0 {
	cdc_acm_uart0: cdc_acm_uart0 {
		compatible = "zephyr,cdc-acm-uart";
	};
};
```

## src/main.cpp
```c
/*
 * Copyright (c) 2023 Nordic Semiconductor ASA
 *
 * SPDX-License-Identifier: LicenseRef-Nordic-5-Clause
 */

#include "phaco_if.h"

static const struct device *radio_dev = DEVICE_DT_GET(DT_CHOSEN(zephyr_ieee802154));
static struct ieee802154_radio_api *radio_api;
static const struct shell *uart_shell;
static bool heartbeat_led_state;
static bool packet_led_state;
static k_timeout_t heartbeat_interval;

static void heartbeat(struct k_work *work);

static K_WORK_DELAYABLE_DEFINE(heartbeat_work, heartbeat);

static void heartbeat(struct k_work *work)
{
	ARG_UNUSED(work);

	heartbeat_led_state = !heartbeat_led_state;
	dk_set_led(DK_LED1, heartbeat_led_state);
	k_work_reschedule(&heartbeat_work, heartbeat_interval);
}

enum net_verdict ieee802154_handle_ack(struct net_if *iface,
				       struct net_pkt *pkt)
{
	ARG_UNUSED(iface);
	ARG_UNUSED(pkt);

	return NET_DROP;
}

int net_recv_data(struct net_if *iface, struct net_pkt *pkt)
{
	if (!pkt) {
		return -EINVAL;
	}

	if (net_pkt_is_empty(pkt)) {
		return -ENODATA;
	}

	uint8_t *psdu = net_buf_frag_last(pkt->buffer)->data;
	size_t length = net_buf_frags_len(pkt->buffer);
	uint8_t lqi = net_pkt_ieee802154_lqi(pkt);
	int8_t rssi = net_pkt_ieee802154_rssi_dbm(pkt);
	struct net_ptp_time *pkt_time = net_pkt_timestamp(pkt);
	uint64_t timestamp =
		pkt_time->second * USEC_PER_SEC + pkt_time->nanosecond / NSEC_PER_USEC;

	packet_led_state = !packet_led_state;
	dk_set_led(DK_LED4, packet_led_state);

	IEEE802154Parser parser;
	parser.phaco_feed_tx(psdu, length, lqi, rssi, timestamp);
	
	net_pkt_unref(pkt);

	return 0;
}

static int cmd_channel(const struct shell *shell, size_t argc, char **argv)
{
	uint32_t channel;

	switch (argc) {
	case 1:
		shell_print(shell, "%d", nrf_802154_channel_get());
		break;
	case 2:
		channel = atoi(argv[1]);
		radio_api->set_channel(radio_dev, channel);
		break;
	default:
		shell_print(shell, "invalid number of parameters: %d", argc);
		break;
	}

	return 0;
}
SHELL_CMD_ARG_REGISTER(channel, NULL, "Set radio channel", cmd_channel, 1, 1);

static int cmd_receive(const struct shell *shell, size_t argc, char **argv)
{
	ARG_UNUSED(shell);
	ARG_UNUSED(argc);
	ARG_UNUSED(argv);

	heartbeat_interval = K_MSEC(250);
	radio_api->start(radio_dev);

	return 0;
}
SHELL_CMD_ARG_REGISTER(receive, NULL, "Put radio in receive state", cmd_receive, 1, 0);

static int cmd_sleep(const struct shell *shell, size_t argc, char **argv)
{
	ARG_UNUSED(shell);
	ARG_UNUSED(argc);
	ARG_UNUSED(argv);

	heartbeat_interval = K_SECONDS(1);
	radio_api->stop(radio_dev);

	return 0;
}
SHELL_CMD_ARG_REGISTER(sleep, NULL, "Disable the radio", cmd_sleep, 1, 0);

int main(void)
{
	(void) dk_leds_init();

	uart_shell = shell_backend_uart_get_ptr();
	heartbeat_interval = K_SECONDS(1);
	k_work_reschedule(&heartbeat_work, heartbeat_interval);

	struct ieee802154_config config = {
		.promiscuous = true
	};

	radio_api = (struct ieee802154_radio_api *)radio_dev->api;
	__ASSERT_NO_MSG(radio_api);

	#if !IS_ENABLED(CONFIG_NRF_802154_SERIALIZATION)
		/* The serialization API does not support disabling the auto-ack. */
		nrf_802154_auto_ack_set(false);
	#endif

	radio_api->configure(radio_dev, IEEE802154_CONFIG_PROMISCUOUS, &config);

	// Initialize CDC ACM
    if (!device_is_ready(IEEE802154Parser::cdc_dev)) {
        return -ENODEV;
    }

    if (usb_enable(NULL)) {
        return -ENODEV;
    }

	return 0;
}
```

## include/beacon_maps.h
```c
#pragma once

#include <map>
#include <cstdint>

namespace beacon_maps {

    const std::map<uint8_t, const char*> network_state_map = {
        {0, "Network Idle"},
        {1, "Reserved"},
        {2, "Network Footswitch Active"},
        {3, "Network Pairing"}
    };

    const std::map<uint8_t, const char*> beacon_source_map = {
        {0, "Centurion Console"},
        {1, "Microscope"}
    };

    const std::map<uint8_t, const char*> step_type_map = {
        {0, "Startup"},
        {1, "Shutdown"},
        {2, "Setup"},
        {3, "I/A"},
        {4, "Phaco"},
        {5, "AutoSert (IOL Injection)"},
        {6, "Coagulation"},
        {7, "Vitrectomy"},
        {8, "Irrigation Footswitch"},
        {9, "Fill"},
        {10, "AutoCap (Capsulotomy)"},
        {11, "Service"},
        {12, "V+V (SGS)"},
        {13, "End of Case"}
    };

    const std::map<uint8_t, const char*> step_sub_type_map = {
        {0, "None"},
        {1, "PrePhaco"},
        {2, "Sculpt"},
        {3, "Quad"},
        {4, "Chop"},
        {5, "Epinucleus"},
        {6, "Flip"},
        {7, "UltraChop"},
        {8, "Cortex"},
        {9, "Polish"},
        {10, "Visco"},
        {11, "Anterior Vitrectomy"},
        {12, "Epinucleus Removal"},
        {13, "Peripheral Iridectomy"},
        {14, "Visco Aspiration"},
        {15, "I/A Cut"},
        {16, "Position"},
        {17, "Incision"},
        {18, "Centration"},
        {19, "Toric"},
        {20, "Registration"},
        {21, "Capsularhexis"},
        {22, "Pseudophakic"},
        {23, "Aphakic"},
        {24, "Axis Marker"},
        {25, "Cut I/A"}
    };
} // namespace beacon_maps
```

## include/phaco_if.h
```c
#pragma once

#include <stdint.h>
#include <stddef.h>
#include <stdlib.h>
#include <string.h>
#include <vector>

#include <zephyr/kernel.h>
#include <zephyr/net/ieee802154_radio.h>
#include <zephyr/shell/shell.h>
#include <zephyr/shell/shell_uart.h>
#include <zephyr/drivers/uart.h>
#include <zephyr/usb/usb_device.h>
#include <zephyr/logging/log.h>
#include <nrf_802154.h>
#include <nrf_802154_const.h>
#include <dk_buttons_and_leds.h>

class IEEE802154Parser {
public:
    static constexpr size_t MAX_BUFFER_SIZE = 256;
    static constexpr size_t BEACON_PACKET_SIZE = 64;
    static constexpr size_t FRAME_CONTROL_SIZE = 2;
    static constexpr size_t SEQ_NUM_SIZE = 1;
    static constexpr size_t ADDRESS_INFO_SIZE = 11;
    static constexpr size_t CRC_SIZE = 2;

private:
    
    uint8_t decode_bits(uint8_t byte_val, uint8_t start_bit, uint8_t end_bit);

    struct beacon_fields {
        uint8_t network_state;         // byte 0, bits 0-2
        uint8_t beacon_source;         // byte 0, bits 3-5
        uint16_t footswitch_id;        // bytes 4-5
        bool sm_overlay;               // byte 6, bit 7
        bool sg_enable;                // byte 7, bit 7
        uint8_t step_type;             // byte 9, bits 0-4
        uint8_t packet_slot_id;        // byte 10, bits 0-4
        bool payload_type;             // byte 10, bit 5
        uint8_t step_sub_type;         // byte 11, bits 0-5
        bool sm_active;                // byte 12, bit 0
        bool sg_active;                // byte 12, bit 1
        bool sm_fsw_active;            // byte 12, bit 3
        uint8_t wireless_channel;      // byte 16
    };

    struct config_fields {
        uint16_t range2_vacuum_limit_end;
    };

    struct status_fields {
        uint8_t footswitch_treadle_range;
        uint8_t iop;
        int16_t irrigation_pressure;
        bool reflux_active;
        bool continuous_irrigation;
        uint8_t range_penetration;
        int16_t aspiration_pressure;
        uint8_t uls_longitudinal_power;
        uint8_t uls_torsional_amplitude;
        uint8_t message_counter;
    };

    char tx_buffer[MAX_BUFFER_SIZE];
    uint8_t network_state;
    uint8_t beacon_source;
    uint16_t footswitch_id;
    bool payload_type;
    uint8_t step_type;
    uint8_t channel;

public:
    IEEE802154Parser() : payload_type(false), step_type(0) {}

    static const struct device *cdc_dev;

    void phaco_feed_tx(const uint8_t* data, 
                        size_t length,
                        uint8_t lqi,
                        int8_t rssi,
                        uint64_t timestamp);
};
```

## src/phaco_if.cpp
```c
#include "phaco_if.h"
#include "beacon_maps.h"

LOG_MODULE_REGISTER(phaco_if, CONFIG_UART_LOG_LEVEL);

// CDC-ACM device from the device tree
const struct device *IEEE802154Parser::cdc_dev = DEVICE_DT_GET_ONE(zephyr_cdc_acm_uart);

uint8_t IEEE802154Parser::decode_bits(uint8_t byte_val, uint8_t start_bit, uint8_t end_bit) {
    uint8_t mask = ((1 << (end_bit - start_bit + 1)) - 1) << start_bit;
    return (byte_val & mask) >> start_bit;
}

void IEEE802154Parser::phaco_feed_tx(const uint8_t* psdu, 
                                     size_t length, 
                                     uint8_t lqi, 
                                     int8_t rssi, 
                                     uint64_t timestamp) {
    size_t header_size = FRAME_CONTROL_SIZE + SEQ_NUM_SIZE + ADDRESS_INFO_SIZE;
    if (length < header_size + CRC_SIZE) return;
    
    // Calculate the payload size based on 802.15.4 offsets and total buffer size
    size_t payload_size = length - header_size - CRC_SIZE;
    const size_t buf_size = sizeof(tx_buffer);

    // Packet ID 
    int beacon_tx = 0;
    if (length < (header_size + BEACON_PACKET_SIZE + CRC_SIZE)) {
        beacon_tx = snprintk(tx_buffer, buf_size, "<MALFORMED PACKET> ");
    } else {
        beacon_tx = snprintk(tx_buffer, buf_size, "<BEACON PACKET> ");
    }

    // Packet QoS 
    beacon_tx += snprintk(tx_buffer + beacon_tx, buf_size - beacon_tx,
                        "TS: %lluus|PS: %zu|LQI: %u|RSSI: %ddBm\n",
                        (unsigned long long)timestamp,
                        payload_size,
                        (unsigned int)lqi,
                        (int)rssi);

    // Beacon Packet
    const uint8_t* beacon_data = psdu + header_size;

    beacon_fields beacon{
        .network_state = decode_bits(beacon_data[0], 0, 2),
        .beacon_source = decode_bits(beacon_data[0], 3, 5),
        .footswitch_id = static_cast<uint16_t>((beacon_data[4] << 8) | beacon_data[5]),
        .sm_overlay = static_cast<bool>(decode_bits(beacon_data[6], 7, 7)),
        .sg_enable = static_cast<bool>(decode_bits(beacon_data[7], 7, 7)),
        .step_type = decode_bits(beacon_data[9], 0, 4),
        .packet_slot_id = decode_bits(beacon_data[10], 0, 4),
        .payload_type = static_cast<bool>(decode_bits(beacon_data[10], 5, 5)),
        .step_sub_type = decode_bits(beacon_data[11], 0, 5),
        .sm_active = static_cast<bool>(decode_bits(beacon_data[12], 0, 0)),
        .sg_active = static_cast<bool>(decode_bits(beacon_data[12], 1, 1)),
        .sm_fsw_active = static_cast<bool>(decode_bits(beacon_data[12], 3, 3)),
        .wireless_channel = beacon_data[16]
    };

    beacon_tx += snprintk(tx_buffer + beacon_tx, buf_size - beacon_tx,
        "NS: %s\n"
        "FSID: %u\n"
        "ST: %s\n"
        "PT: %s\n",
        beacon_maps::network_state_map.at(beacon.network_state),
        beacon.footswitch_id,
        beacon_maps::step_type_map.at(beacon.step_type),
        beacon.payload_type ? "Status" : "Setup"
    );

    // Config Packet
    if (beacon.packet_slot_id == 8) {
        const uint8_t* config_payload = beacon_data + 22;

        config_fields config{
            .range2_vacuum_limit_end = static_cast<uint16_t>((config_payload[6] << 8) | config_payload[7])
        };

        beacon_tx += snprintk(tx_buffer + beacon_tx, buf_size - beacon_tx,
            "VacLE: %ummHg\n",
            config.range2_vacuum_limit_end
        );
    }
                        
    // Status Packet
    if (beacon.payload_type) {
        const uint8_t* status_payload = beacon_data  + 38; // Status payload starts at byte 38
        static uint8_t message_counter_ = 0; 

        status_fields status{
            .footswitch_treadle_range = decode_bits(status_payload[1], 4, 5),
            .iop = status_payload[10],
            .irrigation_pressure = static_cast<int16_t>((status_payload[12] << 8) | status_payload[13]),
            .reflux_active = static_cast<bool>(decode_bits(status_payload[14], 0, 0)),
            .continuous_irrigation = static_cast<bool>(decode_bits(status_payload[14], 5, 5)),
            .range_penetration = decode_bits(status_payload[15], 0, 6),
            .aspiration_pressure = static_cast<int16_t>((status_payload[16] << 8) | status_payload[17]),
            .uls_longitudinal_power = status_payload[2],
            .uls_torsional_amplitude = status_payload[3],
            .message_counter = static_cast<uint8_t>(message_counter_ % 16)
        };
        message_counter_++;
        
        beacon_tx += snprintk(tx_buffer + beacon_tx, buf_size - beacon_tx,
            "FSTrdl: %u|"
            "IOPr: %ummHg|"
            "IrrPr: %dmmHg|"
            "Reflux: %s|"
            "CIrr: %s|"
            "FSPen: %u|"
            "AsPr: %dmmHg|"
            "LonPwr: %u%%|"
            "TorAmp: %u%%\n"
            "MC: %u\n",
            status.footswitch_treadle_range,
            status.iop,
            status.irrigation_pressure,
            (status.reflux_active ? "Active" : "Inactive"),
            (status.continuous_irrigation ? "Active" : "Not Active"),
            status.range_penetration,
            status.aspiration_pressure,
            status.uls_longitudinal_power,
            status.uls_torsional_amplitude,
            status.message_counter
        );
    }

    // Transmit data to the USB CDC driver (non-blocking)
    size_t to_send = MIN((size_t)beacon_tx, buf_size - 1);
    int num_written = uart_fifo_fill(cdc_dev, reinterpret_cast<const uint8_t *>(tx_buffer), to_send);

    // Error checks
    if (num_written < (int)to_send) {
        LOG_ERR("UART FIFO accepted only %d of %zu bytes", num_written, to_send);
    }

    if (beacon_tx < 0) {
        LOG_ERR("Beacon decode failed with error: %d", beacon_tx);
        return;
    }

    if ((size_t)beacon_tx >= buf_size) {
        LOG_ERR("Buffer full, skipped packet");
        return;
    }
    
    k_sleep(K_MSEC(5));
}
```
